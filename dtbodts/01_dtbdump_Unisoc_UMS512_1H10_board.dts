/dts-v1/;

/ {
	compatible = "sprd,ums512-1h10";
	model = "Unisoc UMS512 1H10 board";
	sprd,sc-id = "ums512 X6816D 1000";

	__fixups__ {
		adi_bus = "/fragment@21:target:0";
		aon_clk = "/fragment/__overlay__/sprd-marlin3:clocks:0", "/fragment@8/__overlay__/ak4377@10:clocks:0";
		aon_i2c0 = "/fragment@11:target:0";
		aonapb_gate = "/fragment/__overlay__/sprd-marlin3:clocks:12", "/fragment@8/__overlay__/ak4377@10:clocks:16";
		ap_gpio = "/fragment/__overlay__/fingerprint@0:reset-gpio:0", "/fragment/__overlay__/gpio-keys/key-volumedown:gpios:0", "/fragment/__overlay__/sprd-marlin3:m2-to-ap-coexist-gpios:0", "/fragment/__overlay__/sprd-marlin3:m2-wakeup-ap-gpios:0", "/fragment/__overlay__/sprd-marlin3:permit-ap-send-gpios:0", "/fragment/__overlay__/sprd-marlin3:reset-gpios:0", "/fragment/__overlay__/sprd-marlin3:enable-gpios:0", "/fragment/__overlay__/sprd-marlin3:m2-to-ap-irq-gpios:0", "/fragment@6/__overlay__/sensor-main@20:reset-gpios:0", "/fragment@6/__overlay__/sensor-main@20:power-down-gpios:0", "/fragment@6/__overlay__/sensor-sub@5a:reset-gpios:0", "/fragment@6/__overlay__/sensor-sub@5a:power-down-gpios:0", "/fragment@7/__overlay__/sensor-main2@20:power-down-gpios:0", "/fragment@8/__overlay__/ak4377@10:ak4377,pdn-gpio:0", "/fragment@9/__overlay__/nxpnci@28:nxp,ven-gpio:0", "/fragment@9/__overlay__/nxpnci@28:nxp,firm-gpio:0", "/fragment@9/__overlay__/nxpnci@28:nxp,clkreq-gpio:0", "/fragment@9/__overlay__/nxpnci@28:nxp,irq-gpio:0", "/fragment@10/__overlay__/tcs3430@39:interrupt-parent:0", "/fragment@10/__overlay__/vl53l0@52:interrupt-parent:0", "/fragment@10/__overlay__/flash-ic@63:PCB_verison_detect_gpio:0", "/fragment@10/__overlay__/flash-ic_aw36515@63:PCB_verison_detect_gpio:0", "/fragment@12/__overlay__/led-controller@180:charge,light-gpio:0", "/fragment@13/__overlay__:reset-gpio:0", "/fragment@15/__overlay__:sprd,spk-ext-pa-gpio:0";
		chosen = "/fragment@0:target:0";
		csi0 = "/fragment@6/__overlay__/sensor-main@20:csi:0";
		csi1 = "/fragment@6/__overlay__/sensor-sub@5a:csi:0", "/fragment@7/__overlay__/sensor-main2@20:csi:0";
		ddr_dfs = "/fragment@16:target:0";
		dpu = "/fragment@14:target:0", "/fragment@25:target:0";
		dvfs_dcdc_cpu0_supply = "/fragment@22:target:0";
		dvfs_dcdc_cpu1_supply = "/fragment@23:target:0";
		eic_async = "/fragment/__overlay__/fingerprint@0:irq-gpio:0";
		eic_sync = "/fragment@2/__overlay__:cd-gpios:0";
		ext_26m = "/fragment@6/__overlay__/sensor-main@20:clocks:40", "/fragment@6/__overlay__/sensor-sub@5a:clocks:40", "/fragment@7/__overlay__/sensor-main2@20:clocks:40";
		ext_32k = "/fragment/__overlay__/sprd-marlin3:clocks:8";
		extcon_gpio = "/fragment@9/__overlay__/charger@6a:extcon:0", "/fragment@19/__overlay__:extcon:0";
		hsphy = "/fragment@9/__overlay__/charger@6a:phys:0";
		i2c0 = "/fragment@6:target:0";
		i2c1 = "/fragment@7:target:0";
		i2c2 = "/fragment@8:target:0";
		i2c3 = "/fragment@9:target:0";
		i2c4 = "/fragment@10:target:0";
		ion = "/fragment@5:target:0", "/fragment@24:target:0";
		mm_clk = "/fragment@6/__overlay__/sensor-main@20:clocks:0", "/fragment@6/__overlay__/sensor-sub@5a:clocks:0", "/fragment@7/__overlay__/sensor-main2@20:clocks:0";
		mm_gate = "/fragment@6/__overlay__/sensor-main@20:clocks:8", "/fragment@6/__overlay__/sensor-sub@5a:clocks:8", "/fragment@7/__overlay__/sensor-main2@20:clocks:8";
		panel = "/fragment@13:target:0";
		pin_controller = "/fragment@3:target:0";
		pll2 = "/fragment@6/__overlay__/sensor-main@20:clocks:16", "/fragment@6/__overlay__/sensor-main@20:clocks:24", "/fragment@6/__overlay__/sensor-main@20:clocks:32", "/fragment@6/__overlay__/sensor-sub@5a:clocks:16", "/fragment@6/__overlay__/sensor-sub@5a:clocks:24", "/fragment@6/__overlay__/sensor-sub@5a:clocks:32", "/fragment@7/__overlay__/sensor-main2@20:clocks:16", "/fragment@7/__overlay__/sensor-main2@20:clocks:24", "/fragment@7/__overlay__/sensor-main2@20:clocks:32", "/fragment@8/__overlay__/ak4377@10:clocks:8";
		pmic_adc = "/fragment/__overlay__/thermal-sensor:io-channels:0";
		pmic_eic = "/fragment/__overlay__/gpio-keys/key-volumeup:gpios:0", "/fragment/__overlay__/gpio-keys/key-power:gpios:0";
		pmic_fgu = "/fragment@17:target:0";
		pmic_pd = "/fragment@18:target:0";
		pmic_typec = "/fragment/__overlay__/charger-manager/regulator@0/cable@0:extcon:0", "/fragment@19/__overlay__:extcon:4";
		reserved_memory = "/fragment@1:target:0";
		sc2730_pmic = "/fragment@12:target:0";
		sdio0 = "/fragment@2:target:0";
		sdio1 = "/fragment/__overlay__/sprd-marlin3:sdhci-name:0";
		sound_vbc_v4_sprd_codec = "/fragment@15:target:0";
		thm_zone = "/fragment@4:target:0";
		uid_end = "/fragment/__overlay__/sprd_uid:nvmem-cells:4";
		uid_start = "/fragment/__overlay__/sprd_uid:nvmem-cells:0";
		usb = "/fragment@19:target:0";
		vddcama0 = "/fragment@6/__overlay__/sensor-main@20:vddcama-supply:0", "/fragment@6/__overlay__/sensor-sub@5a:vddcama-supply:0";
		vddcama1 = "/fragment@7/__overlay__/sensor-main2@20:vddcama-supply:0";
		vddcamd0 = "/fragment@6/__overlay__/sensor-main@20:vddcamd-supply:0", "/fragment@6/__overlay__/sensor-sub@5a:vddcamd-supply:0";
		vddcamd1 = "/fragment@7/__overlay__/sensor-main2@20:vddcamd-supply:0";
		vddcamio = "/fragment@6/__overlay__/sensor-main@20:vddio-supply:0", "/fragment@6/__overlay__/sensor-sub@5a:vddio-supply:0", "/fragment@7/__overlay__/sensor-main2@20:vddio-supply:0";
		vddcammot = "/fragment@6/__overlay__/sensor-main@20:vddcammot-supply:0", "/fragment@6/__overlay__/sensor-sub@5a:vddcammot-supply:0", "/fragment@7/__overlay__/sensor-main2@20:vddcammot-supply:0";
		vddldo0 = "/fragment@20:target:0";
		vddldo1 = "/fragment@8/__overlay__/ak4377@10:vddldo1-supply:0";
		vddsim2 = "/fragment/__overlay__/sprd-marlin3:dcxo18-supply:0";
		vddwcn = "/fragment/__overlay__/sprd-marlin3:avdd12-supply:0";
		vddwifipa = "/fragment/__overlay__/sprd-marlin3:avdd33-supply:0";
	};

	__local_fixups__ {

		fragment {

			__overlay__ {

				charger-manager {
					monitored-battery = <0x0>;
				};
			};
		};

		fragment@17 {

			__overlay__ {
				monitored-battery = <0x0>;
			};
		};

		fragment@19 {

			__overlay__ {
				vbus-supply = <0x0>;
			};
		};

		fragment@24 {

			__overlay__ {

				heap@3 {
					memory-region = <0x0>;
				};
			};
		};

		fragment@25 {

			__overlay__ {
				sprd,logo-memory = <0x0>;
				sprd,wb-memory = <0x0>;
			};
		};

		fragment@3 {

			__overlay__ {
				pinctrl-0 = <0x0>;
				pinctrl-1 = <0x0>;
				pinctrl-10 = <0x0>;
				pinctrl-2 = <0x0>;
				pinctrl-3 = <0x0>;
				pinctrl-4 = <0x0>;
				pinctrl-5 = <0x0>;
				pinctrl-6 = <0x0>;
				pinctrl-7 = <0x0>;
				pinctrl-8 = <0x0>;
				pinctrl-9 = <0x0>;
			};
		};

		fragment@4 {

			__overlay__ {

				board-thmzone {
					thermal-sensors = <0x0>;
				};
			};
		};

		fragment@5 {

			__overlay__ {

				heap@4 {
					memory-region = <0x0>;
				};

				heap@5 {
					memory-region = <0x0>;
				};
			};
		};

		fragment@9 {

			__overlay__ {

				charger@6a {
					monitored-battery = <0x0>;
				};
			};
		};
	};

	__symbols__ {
		ak4377_hifi = "/fragment@8/__overlay__/ak4377@10";
		ams_tcs3430 = "/fragment@10/__overlay__/tcs3430@39";
		aw32207_chg = "/fragment@9/__overlay__/charger@6a";
		bat = "/fragment/__overlay__/battery";
		bd_thmzone = "/fragment@4/__overlay__/board-thmzone";
		fan53555_dcdc = "/fragment@11/__overlay__/regulator@60";
		fb_reserved = "/fragment@1/__overlay__/framebuffer-mem@fd708000";
		fd_reserved = "/fragment@1/__overlay__/faceid-mem@efaae000";
		flash_ic = "/fragment@10/__overlay__/flash-ic@63";
		flash_ic_aw36515 = "/fragment@10/__overlay__/flash-ic_aw36515@63";
		gpio_121 = "/fragment@3/__overlay__/keyout0";
		gpio_122 = "/fragment@3/__overlay__/keyout1";
		gpio_123 = "/fragment@3/__overlay__/keyout2";
		gpio_124 = "/fragment@3/__overlay__/keyin0";
		gpio_125 = "/fragment@3/__overlay__/keyin1";
		gpio_126 = "/fragment@3/__overlay__/keyin2";
		gpio_144 = "/fragment@3/__overlay__/extint0";
		gpio_145 = "/fragment@3/__overlay__/extint1";
		gpio_146 = "/fragment@3/__overlay__/sda3";
		gpio_147 = "/fragment@3/__overlay__/scl3";
		gpio_16 = "/fragment@3/__overlay__/rffe1_sda";
		logo_reserved = "/fragment@1/__overlay__/logobuffer@9e000000";
		sensor_main = "/fragment@6/__overlay__/sensor-main@20";
		sensor_main2 = "/fragment@7/__overlay__/sensor-main2@20";
		sensor_sub = "/fragment@6/__overlay__/sensor-sub@5a";
		sprd_marlin3 = "/fragment/__overlay__/sprd-marlin3";
		stm_vl53l0 = "/fragment@10/__overlay__/vl53l0@52";
		tboard_thermistor = "/fragment/__overlay__/thermal-sensor";
		usb_con = "/fragment@18/__overlay__/connector";
		vddvbus = "/fragment@9/__overlay__/charger@6a/otg-vbus";
		vdsp_reserved = "/fragment@1/__overlay__/vdsp-mem@f09ae000";
		wb_reserved = "/fragment@1/__overlay__/writeback-mem@ff562000";
	};

	fragment {
		target-path = [2f 00];

		__overlay__ {

			battery {
				capacity-temp-table = <0x2d 0x64 0x19 0x64 0xa 0x62 0x0 0x5d 0xfffffff6 0x55 0xffffffec 0x40>;
				charge-cdp-current-microamp = <0x1e8480 0x1e8480>;
				charge-dcp-current-microamp = <0x1e8480 0x1e8480>;
				charge-full-design-microamp-hours = <0x5b1850>;
				charge-sdp-current-microamp = <0x7a120 0x7a120>;
				charge-term-current-microamp = <0x2bf20>;
				charge-unknown-current-microamp = <0x124f80 0x124f80>;
				compatible = "simple-battery";
				constant_charge_voltage_max_microvolt = <0x432380>;
				factory-internal-resistance-micro-ohms = <0x1fbd0>;
				ocv-capacity-celsius = <0x14>;
				ocv-capacity-table-0 = <0x42c1d8 0x64 0x41f2d0 0x5f 0x410870 0x5a 0x4021f8 0x55 0x3f4350 0x50 0x3e6c78 0x4b 0x3db8c8 0x46 0x3cda20 0x41 0x3c5550 0x3c 0x3b95e8 0x37 0x3ad680 0x32 0x3a70f0 0x2d 0x3a1ee8 0x28 0x39e068 0x23 0x39b188 0x1e 0x396b38 0x19 0x3924e8 0x14 0x38d6c8 0xf 0x3851f8 0xa 0x37e880 0x5 0x33e140 0x0>;
				phandle = <0x1>;
				resistance-temp-table = <0x2d 0x4d 0x19 0x64 0xa 0x222 0x0 0x301 0xfffffff6 0x37c 0xffffffec 0x39b>;
				voltage-min-design-microvolt = <0x34a490>;
				voltage-temp-table = <0x10b558 0x320 0xf0b90 0x352 0xd65b0 0x384 0xbd358 0x3b6 0xa5870 0x3e8 0x900b0 0x41a 0x7c830 0x44c 0x6b6c0 0x47e 0x5c490 0x4b0 0x4f1a0 0x4e2 0x43df0 0x514 0x3a1b0 0x546 0x31ce0 0x578 0x2ab98 0x5aa 0x249f0 0x5dc 0x1f7e8 0x60e 0x1b198 0x640 0x17700 0x672>;
			};

			charger-manager {
				cm-battery-cold = <0xc8>;
				cm-battery-cold-in-minus;
				cm-battery-hot = <0x320>;
				cm-battery-stat = <0x2>;
				cm-battery-temp-diff = <0x32>;
				cm-cap-remap-table = <0x1 0x2 0x3 0x2 0x3 0x2 0x62 0x63 0x2 0x63 0x64 0x3>;
				cm-capacity-track;
				cm-cdp-jeita-temp-table = <0x3e8 0x406 0x0 0x434a90 0x47e 0x49c 0xaae60 0x434a90 0x5aa 0x58c 0x1e8480 0x434a90 0x60e 0x5dc 0xaae60 0x3e8fa0>;
				cm-charge-voltage-drop = <0x493e0>;
				cm-charge-voltage-max = <0x5e9ac0>;
				cm-chargers = "aw32207_charger";
				cm-charging-max = <0x3dcc500>;
				cm-dcp-jeita-temp-table = <0x3e8 0x406 0x0 0x434a90 0x47e 0x49c 0xaae60 0x434a90 0x5aa 0x58c 0x1e8480 0x434a90 0x60e 0x5dc 0xaae60 0x3e8fa0>;
				cm-discharging-max = <0x6ddd00>;
				cm-fuel-gauge = "sc27xx-fgu";
				cm-fullbatt-capacity = <0x64>;
				cm-fullbatt-current = <0x2bf20>;
				cm-fullbatt-vchkdrop-ms = <0x7530>;
				cm-fullbatt-vchkdrop-volt = <0xd6d8>;
				cm-fullbatt-voltage = <0x4273b8>;
				cm-name = "battery";
				cm-num-chargers = <0x1>;
				cm-one-cap-time = <0x1e>;
				cm-poll-interval = <0x3a98>;
				cm-poll-mode = <0x2>;
				cm-sdp-jeita-temp-table = <0x3e8 0x406 0x0 0x434a90 0x47e 0x49c 0x7a120 0x434a90 0x5aa 0x58c 0x7a120 0x434a90 0x60e 0x5dc 0x7a120 0x3e8fa0>;
				cm-shutdown-voltage = <0x2f4d60>;
				cm-thermal-zone = "board-thmzone";
				cm-tickle-time-out = <0x5dc>;
				cm-unknown-jeita-temp-table = <0x3e8 0x406 0x0 0x434a90 0x47e 0x49c 0xaae60 0x434a90 0x5aa 0x58c 0x124f80 0x434a90 0x60e 0x5dc 0xaae60 0x3e8fa0>;
				cm-wdt-interval = <0x3c>;
				compatible = "charger-manager";
				monitored-battery = <0x1>;

				regulator@0 {
					cm-regulator-name = "vddgen0";

					cable@0 {
						cm-cable-name = "USB";
						extcon = <0xffffffff>;
					};
				};
			};

			fingerprint@0 {
				compatible = "focaltech,fingerprint";
				irq-gpio = <0xffffffff 0xd 0x0>;
				reset-gpio = <0xffffffff 0x83 0x0>;
			};

			gpio-keys {
				compatible = "gpio-keys";

				key-power {
					debounce-interval = <0x2>;
					gpios = <0xffffffff 0x1 0x1>;
					label = "Power Key";
					linux,code = <0x74>;
					wakeup-source;
				};

				key-volumedown {
					debounce-interval = <0x2>;
					gpios = <0xffffffff 0x7c 0x1>;
					label = "Volume Down Key";
					linux,code = <0x72>;
					wakeup-source;
				};

				key-volumeup {
					debounce-interval = <0x2>;
					gpios = <0xffffffff 0x4 0x0>;
					label = "Volume Up Key";
					linux,code = <0x73>;
					wakeup-source;
				};
			};

			sprd-marlin3 {
				adma-rx;
				adma-tx;
				avdd12-bound-wbreq = <0x1ac8 0x1000 0x0 0x1000>;
				avdd12-parent-bound-chip = <0x1a4c 0x1 0x0 0x1>;
				avdd12-supply = <0xffffffff>;
				avdd33-bound-wbreq = <0x1acc 0x4 0x0 0x4>;
				avdd33-supply = <0xffffffff>;
				clock-names = "clk_32k", "source", "enable";
				clocks = <0xffffffff 0x2 0xffffffff 0xffffffff 0x3>;
				compatible = "sprd,marlin3";
				dcxo18-supply = <0xffffffff>;
				enable-gpios = <0xffffffff 0x8f 0x1>;
				m2-to-ap-coexist-gpios = <0xffffffff 0x7 0x1>;
				m2-to-ap-irq-gpios = <0xffffffff 0x5e 0x1>;
				m2-wakeup-ap-gpios = <0xffffffff 0x20 0x1>;
				permit-ap-send-gpios = <0xffffffff 0x79 0x1>;
				phandle = <0x14>;
				reset-gpios = <0xffffffff 0x5f 0x1>;
				sdhci-name = <0xffffffff>;
				sprd,btwf-file-name = "/dev/block/platform/soc/soc:ap-apb/71400000.sdio/by-name/wcnmodem";
				sprd,gnss-file-name = "/dev/block/platform/soc/soc:ap-apb/71400000.sdio/by-name/gnssmodem";
				xtal-26m-clk-type = "TSX";
			};

			sprd-wlan {
				compatible = "sprd,sc2355-wifi";
			};

			sprd_uid {
				compatible = "sprd-uid";
				nvmem-cell-names = "uid_start", "uid_end";
				nvmem-cells = <0xffffffff 0xffffffff>;
			};

			thermal-sensor {
				#thermal-sensor-cells = <0x0>;
				compatible = "generic-adc-thermal";
				io-channel-names = "sensor-channel";
				io-channels = <0xffffffff 0x1>;
				phandle = <0xd>;
				temperature-lookup-table = <0xffff64c2 0x46b 0xffff8baf 0x456 0xffffb3e8 0x432 0xffffedb9 0x3d7 0x277e 0x346 0x60e5 0x28e 0xaf7a 0x19d 0xd677 0x13c 0xfd7f 0xee 0x12484 0xb2 0x14b93 0x85 0x172a3 0x64 0x199b0 0x4b 0x1c0c9 0x39 0x1e7c8 0x2b>;
			};
		};
	};

	fragment@0 {
		target = <0xffffffff>;

		__overlay__ {
			bootargs_ext = "androidboot.hardware=X6816D androidboot.dtbo_idx=0";
			transsion,emi-support = "H9AG9G5ANBX100", "KMDP6001DB-B425";
		};
	};

	fragment@1 {
		target = <0xffffffff>;

		__overlay__ {

			faceid-mem@efaae000 {
				phandle = <0xe>;
				reg = <0x0 0xefaae000 0x0 0x500000>;
			};

			framebuffer-mem@fd708000 {
				phandle = <0x11>;
				reg = <0x0 0xfd708000 0x0 0x1e5a000>;
			};

			logobuffer@9e000000 {
				phandle = <0x13>;
				reg = <0x0 0x9e000000 0x0 0x9e4000>;
			};

			vdsp-mem@f09ae000 {
				phandle = <0xf>;
				reg = <0x0 0xf09ae000 0x0 0x3700000>;
			};

			writeback-mem@ff562000 {
				phandle = <0x12>;
				reg = <0x0 0xff562000 0x0 0xa1e000>;
			};
		};
	};

	fragment@10 {
		target = <0xffffffff>;

		__overlay__ {
			status = "okay";

			flash-ic@63 {
				PCB_verison_detect_gpio = <0xffffffff 0x89 0x0>;
				compatible = "sprd,flash-ocp81375";
				flash-front-min-current = <0x4b>;
				flash-ic = <0x13ddf>;
				flash-idx = <0x4>;
				led1-max-flash = <0x1e0>;
				led1-max-torch = <0xf0>;
				led1_default_torch = <0x7d>;
				led2-max-flash = <0x76c>;
				led2-max-torch = <0x3d4>;
				led2_default_torch = <0xb4>;
				phandle = <0x1d>;
				reg = <0x63>;
			};

			flash-ic_aw36515@63 {
				PCB_verison_detect_gpio = <0xffffffff 0x89 0x0>;
				compatible = "sprd,flash-aw36515";
				flash-front-min-current = <0x4b>;
				flash-ic = <0x8ea3>;
				flash-idx = <0x4>;
				led1-max-flash = <0x1e0>;
				led1-max-torch = <0xf0>;
				led1_default_torch = <0x7d>;
				led2-max-flash = <0x76c>;
				led2-max-torch = <0x3d4>;
				led2_default_torch = <0xb4>;
				phandle = <0x1e>;
				reg = <0x64>;
			};

			tcs3430@39 {
				als_can_wake = <0x1>;
				als_gain = <0x40>;
				als_name = "ams_als";
				als_time_ms = <0x64>;
				compatible = "ams,tcs3430";
				int_config = <0x0>;
				interrupt-parent = <0xffffffff>;
				interrupts = <0x70 0x8>;
				irq_gpios = <0x70>;
				persist = <0x0>;
				phandle = <0x1b>;
				reg = <0x39>;
			};

			vl53l0@52 {
				compatible = "st,stmvl53l0";
				interrupt-parent = <0xffffffff>;
				interrupts = <0x57 0x8>;
				irq_gpios = <0x57>;
				phandle = <0x1c>;
				reg = <0x52>;
				reset_gpios = <0x56>;
			};
		};
	};

	fragment@11 {
		target = <0xffffffff>;

		__overlay__ {
			clock-frequency = <0xf4240>;
			status = "okay";

			cpudvfs-dcdc-cpu1@62 {
				compatible = "sprd,cpudvfs-regulator-sharkl5pro";
				dvfs-dcdc-i2c = <0x1>;
				reg = <0x62>;
			};

			regulator@60 {
				compatible = "fcs,fan53555";
				fcs,suspend-voltage-selector = <0x1>;
				phandle = <0x1f>;
				reg = <0x60>;
				regulator-always-on;
				regulator-max-microvolt = <0x12c4b0>;
				regulator-min-microvolt = <0x927c0>;
				regulator-name = "fan53555";
				regulator-ramp-delay = <0xfa00>;
			};
		};
	};

	fragment@12 {
		target = <0xffffffff>;

		__overlay__ {

			led-controller@180 {
				charge,light-gpio = <0xffffffff 0x8b 0x0>;

				led@3 {
					label = "transsion";
					reg = <0x3>;
				};
			};
		};
	};

	fragment@13 {
		target = <0xffffffff>;

		__overlay__ {
			reset-gpio = <0xffffffff 0x32 0x0>;
		};
	};

	fragment@14 {
		target = <0xffffffff>;

		__overlay__ {
		};
	};

	fragment@15 {
		target = <0xffffffff>;

		__overlay__ {
			sprd,spk-ext-pa-gpio = <0xffffffff 0x88 0x0>;
			sprd,spk-ext-pa-info = <0x0 0x0 0x2 0x2 0x0>;
			sprd-audio-card,routing = "HPMIC Pin", "HP Mic Jack", "MIC Pin", "Mic Jack", "MIC2 Pin", "Aux Mic Jack", "HeadPhone Jack", "HP Pin", "Ext Spk", "HP Pin", "DMIC Pin", "DMic Jack", "DMIC1 Pin", "DMic1 Jack", "Ext Ear", "EAR Pin";
			status = "okay";
		};
	};

	fragment@16 {
		target = <0xffffffff>;

		__overlay__ {
			sprd-freq = <0x535 0x300 0x100 0x180 0x200 0xbacd 0x535>;
			sprd-scene = "boost", "lcdon", "lcdoff", "camlow", "camhigh", "camveryhigh", "faceid";
		};
	};

	fragment@17 {
		target = <0xffffffff>;

		__overlay__ {
			first-calib-capacity = <0x28>;
			first-calib-voltage = <0x36ee80>;
			monitored-battery = <0x1>;
			sprd,calib-resistance-real = <0x2710>;
			sprd,calib-resistance-spec = <0x4e20>;
		};
	};

	fragment@18 {
		target = <0xffffffff>;

		__overlay__ {
			status = "okay";

			connector {
				compatible = "usb-c-connector";
				label = "USB-C";
				op-sink-microwatt = <0x989680>;
				phandle = <0x20>;
				power-role = "dual";
				sink-pdos = <0x40190c8>;
				source-pdos = <0x4019028>;
				try-power-role = "sink";
			};
		};
	};

	fragment@19 {
		target = <0xffffffff>;

		__overlay__ {
			extcon = <0xffffffff 0xffffffff>;
			vbus-supply = <0x10>;
		};
	};

	fragment@2 {
		target = <0xffffffff>;

		__overlay__ {
			cd-gpios = <0xffffffff 0x13 0x0>;
		};
	};

	fragment@20 {
		target = <0xffffffff>;

		__overlay__ {
			regulator-always-on;
		};
	};

	fragment@21 {
		target = <0xffffffff>;

		__overlay__ {
			sprd,hw-channels = <0x2 0x18cc 0x3 0x18cc 0xd 0x1874 0xf 0x1874 0x11 0x1844 0x13 0x1854 0x15 0x1864 0x1e 0x1820 0x23 0x19b8 0x27 0x19ac>;
		};
	};

	fragment@22 {
		target = <0xffffffff>;

		__overlay__ {
			chnl-in-i2c = <0x0>;
			pmic-type-num = <0x0>;
			slew-rate = <0x249f>;
			top-dvfs-adi-state = <0x70 0x0 0xf>;
			tuning-latency-us = <0x0>;
			voltage-down-delay = <0x32 0x64 0x0 0xffff 0x600 0x64 0x64 0x10 0xffff 0xa00 0x96 0x60 0x0 0xffff 0xf00 0xc8 0x60 0x10 0xffff 0x1400 0xfa 0x5c 0x0 0xffff 0x1900 0x12c 0x5c 0x10 0xffff 0x1e00 0x15e 0x114 0x0 0xffff 0x2300>;
			voltage-grade = <0x0 0xf0 0xf4 0x0 0x1ff 0x1 0xf0 0xf4 0x9 0x1ff 0x2 0x100 0xf4 0x12 0x1ff 0x3 0x110 0xf8 0x0 0x1ff 0x4 0x120 0xf8 0x9 0x1ff 0x5 0x130 0xf8 0x12 0x1ff 0x6 0x140 0xfc 0x0 0x1ff>;
			voltage-grade-num = <0x7>;
			voltage-up-delay = <0x32 0x58 0x0 0xffff 0x600 0x64 0x58 0x10 0xffff 0xa00 0x96 0x54 0x0 0xffff 0xf00 0xc8 0x54 0x10 0xffff 0x1400 0xfa 0x50 0x0 0xffff 0x1900 0x12c 0x50 0x10 0xffff 0x1e00 0x15e 0x110 0x0 0xffff 0x2300>;
		};
	};

	fragment@23 {
		target = <0xffffffff>;

		__overlay__ {
			chnl-in-i2c = <0x0>;
			pmic-type-num = <0x0>;
			slew-rate = <0x249f>;
			supply-type-sel = <0x120 0x0 0x0>;
			top-dvfs-adi-state = <0x9c 0x0 0xf>;
			tuning-latency-us = <0xc8>;
			voltage-down-delay = <0x32 0x90 0x0 0xffff 0x600 0x64 0x90 0x10 0xffff 0xa00 0x96 0x8c 0x0 0xffff 0xf00 0xc8 0x8c 0x10 0xffff 0x1400 0xfa 0x88 0x0 0xffff 0x1900 0x12c 0x88 0x10 0xffff 0x1e00 0x15e 0x11c 0x0 0xffff 0x2300>;
			voltage-grade = <0x0 0xf0 0x100 0x0 0x1ff 0x1 0x100 0x100 0x9 0x1ff 0x2 0x110 0x100 0x12 0x1ff 0x3 0x120 0x104 0x0 0x1ff 0x4 0x130 0x104 0x9 0x1ff 0x5 0x140 0x104 0x12 0x1ff>;
			voltage-grade-num = <0x6>;
			voltage-up-delay = <0x32 0x84 0x0 0xffff 0x1600 0x64 0x84 0x10 0xffff 0xa00 0x96 0x80 0x0 0xffff 0x1f00 0xc8 0x80 0x10 0xffff 0x1400 0xfa 0x7c 0x0 0xffff 0x1900 0x12c 0x7c 0x10 0xffff 0x1e00 0x15e 0x118 0x0 0xffff 0x2300>;
		};
	};

	fragment@24 {
		target = <0xffffffff>;

		__overlay__ {

			heap@3 {
				label = "carveout_fb";
				memory-region = <0x11>;
				reg = <0x3>;
				type = <0x2>;
			};
		};
	};

	fragment@25 {
		target = <0xffffffff>;

		__overlay__ {
			sprd,logo-memory = <0x13>;
			sprd,wb-memory = <0x12>;
		};
	};

	fragment@3 {
		target = <0xffffffff>;

		__overlay__ {
			pinctrl-0 = <0x2>;
			pinctrl-1 = <0x3>;
			pinctrl-10 = <0xc>;
			pinctrl-2 = <0x4>;
			pinctrl-3 = <0x5>;
			pinctrl-4 = <0x6>;
			pinctrl-5 = <0x7>;
			pinctrl-6 = <0x8>;
			pinctrl-7 = <0x9>;
			pinctrl-8 = <0xa>;
			pinctrl-9 = <0xb>;
			pinctrl-names = "gpio_121", "gpio_122", "gpio_123", "gpio_124", "gpio_125", "gpio_126", "gpio_144", "gpio_145", "gpio_146", "gpio_147", "gpio_16";

			extint0 {
				function = "func4";
				phandle = <0x8>;
				pins = "SHARKL5PRO_EXTINT0";
			};

			extint1 {
				function = "func4";
				phandle = <0x9>;
				pins = "SHARKL5PRO_EXTINT1";
			};

			keyin0 {
				function = "func4";
				phandle = <0x5>;
				pins = "SHARKL5PRO_KEYIN0";
			};

			keyin1 {
				function = "func4";
				phandle = <0x6>;
				pins = "SHARKL5PRO_KEYIN1";
			};

			keyin2 {
				function = "func4";
				phandle = <0x7>;
				pins = "SHARKL5PRO_KEYIN2";
			};

			keyout0 {
				function = "func4";
				phandle = <0x2>;
				pins = "SHARKL5PRO_KEYOUT0";
			};

			keyout1 {
				function = "func4";
				phandle = <0x3>;
				pins = "SHARKL5PRO_KEYOUT1";
			};

			keyout2 {
				function = "func4";
				phandle = <0x4>;
				pins = "SHARKL5PRO_KEYOUT2";
			};

			rffe1_sda {
				function = "func4";
				phandle = <0xc>;
				pins = "SHARKL5PRO_RFFE1_SDA";
			};

			scl3 {
				function = "func4";
				phandle = <0xb>;
				pins = "SHARKL5PRO_SCL3";
			};

			sda3 {
				function = "func4";
				phandle = <0xa>;
				pins = "SHARKL5PRO_SDA3";
			};
		};
	};

	fragment@4 {
		target = <0xffffffff>;

		__overlay__ {

			board-thmzone {
				phandle = <0x15>;
				polling-delay = <0x0>;
				polling-delay-passive = <0x0>;
				thermal-sensors = <0xd>;
			};
		};
	};

	fragment@5 {
		target = <0xffffffff>;

		__overlay__ {

			heap@4 {
				label = "carveout_fd";
				memory-region = <0xe>;
				reg = <0x4>;
				type = <0x2>;
			};

			heap@5 {
				label = "carveout_vdsp";
				memory-region = <0xf>;
				reg = <0x5>;
				type = <0x2>;
			};
		};
	};

	fragment@6 {
		target = <0xffffffff>;

		__overlay__ {
			clock-frequency = <0x61a80>;
			status = "okay";

			sensor-main@20 {
				clock-names = "clk_src", "sensor_eb", "clk_96m", "clk_76m8", "clk_48m", "clk_26m";
				clocks = <0xffffffff 0x2 0xffffffff 0xd 0xffffffff 0x4 0xffffffff 0x10 0xffffffff 0x5 0xffffffff>;
				compatible = "sprd,sensor-main";
				csi = <0xffffffff>;
				phandle = <0x16>;
				power-down-gpios = <0xffffffff 0x2e 0x0>;
				reg = <0x20>;
				reset-gpios = <0xffffffff 0x2c 0x0>;
				sprd,phyid = <0x0>;
				vddcama-supply = <0xffffffff>;
				vddcamd-supply = <0xffffffff>;
				vddcammot-supply = <0xffffffff>;
				vddio-supply = <0xffffffff>;
			};

			sensor-sub@5a {
				clock-names = "clk_src", "sensor_eb", "clk_96m", "clk_76m8", "clk_48m", "clk_26m";
				clocks = <0xffffffff 0x2 0xffffffff 0xd 0xffffffff 0x4 0xffffffff 0x10 0xffffffff 0x5 0xffffffff>;
				compatible = "sprd,sensor-sub";
				csi = <0xffffffff>;
				phandle = <0x17>;
				power-down-gpios = <0xffffffff 0x28 0x0>;
				reg = <0x5a>;
				reset-gpios = <0xffffffff 0x29 0x0>;
				sprd,phyid = <0x1>;
				vddcama-supply = <0xffffffff>;
				vddcamd-supply = <0xffffffff>;
				vddcammot-supply = <0xffffffff>;
				vddio-supply = <0xffffffff>;
			};
		};
	};

	fragment@7 {
		target = <0xffffffff>;

		__overlay__ {
			clock-frequency = <0x61a80>;
			status = "okay";

			sensor-main2@20 {
				clock-names = "clk_src", "sensor_eb", "clk_96m", "clk_76m8", "clk_48m", "clk_26m";
				clocks = <0xffffffff 0x3 0xffffffff 0xc 0xffffffff 0x4 0xffffffff 0x10 0xffffffff 0x5 0xffffffff>;
				compatible = "sprd,sensor-main2";
				csi = <0xffffffff>;
				phandle = <0x18>;
				power-down-gpios = <0xffffffff 0x28 0x0>;
				reg = <0x20>;
				sprd,phyid = <0x1>;
				vddcama-supply = <0xffffffff>;
				vddcamd-supply = <0xffffffff>;
				vddcammot-supply = <0xffffffff>;
				vddio-supply = <0xffffffff>;
			};
		};
	};

	fragment@8 {
		target = <0xffffffff>;

		__overlay__ {
			clock-frequency = <0x61a80>;
			status = "okay";

			ak4377@10 {
				#sound-dai-cells = <0x1>;
				ak4377,pdn-gpio = <0xffffffff 0x74 0x0>;
				clock-names = "clk_48M", "source", "enable";
				clocks = <0xffffffff 0x3 0xffffffff 0x13 0xffffffff 0x4>;
				compatible = "akm,ak4376";
				phandle = <0x19>;
				reg = <0x10>;
				sprd,vddldo1-voltage = <0x1b7740>;
				vddldo1-supply = <0xffffffff>;
			};
		};
	};

	fragment@9 {
		target = <0xffffffff>;

		__overlay__ {
			status = "okay";

			charger@6a {
				compatible = "fairchild, aw32207_chg";
				extcon = <0xffffffff>;
				monitored-battery = <0x1>;
				phandle = <0x1a>;
				phys = <0xffffffff>;
				reg = <0x6a>;

				otg-vbus {
					phandle = <0x10>;
					regulator-name = "vddusb33";
				};
			};

			nxpnci@28 {
				compatible = "nxp,pn557";
				nxp,clkreq-gpio = <0xffffffff 0x54 0x0>;
				nxp,firm-gpio = <0xffffffff 0x74 0x0>;
				nxp,irq-gpio = <0xffffffff 0x7e 0x0>;
				nxp,ven-gpio = <0xffffffff 0x60 0x0>;
				reg = <0x28>;
				status = "okay";
			};
		};
	};
};
